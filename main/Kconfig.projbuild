## main/Kconfig.projbuild
```kconfig
menu "Arctic Sniffer Configuration"

    menu "WiFi"
        config WIFI_SSID
            string "WiFi SSID (fallback)"
            default ""
            help
                Fallback WiFi SSID used only when no credentials are stored
                in NVS (i.e. the captive portal has not been used yet).
                Leave empty to always start in provisioning mode.

        config WIFI_PASSWORD
            string "WiFi Password (fallback)"
            default ""
            help
                Fallback WiFi password (paired with the SSID above).

        config MDNS_HOSTNAME
            string "mDNS Hostname (base)"
            default "arctic-sniffer"
            help
                Base mDNS hostname.  On boot the device probes the network
                for collisions and appends a suffix if needed:
                arctic-sniffer.local, arctic-sniffer-2.local, …

        config WIFI_RESET_HOLD_MS
            int "Button hold time to reset WiFi (ms)"
            default 3000
            range 1000 10000
            help
                Hold the front button for this long to erase stored WiFi
                credentials and reboot into provisioning (SoftAP) mode.
    endmenu

    menu "RS-485 / UART"
        config SNIFFER_UART_PORT
            int "UART Port Number"
            default 1
            range 0 2
            help
                UART peripheral to use for RS-485 reception.

        config SNIFFER_UART_TX_PIN
            int "TX GPIO Pin"
            default 6
            help
                TX pin (active but unused — sniffer is receive-only).

        config SNIFFER_UART_RX_PIN
            int "RX GPIO Pin"
            default 5
            help
                RX pin connected to the RS-485 bus.

        config SNIFFER_UART_BAUD
            int "Baud Rate"
            default 2400
            help
                Baud rate for the Modbus RTU bus.
    endmenu

    menu "Display & Button"

        config SNIFFER_LCD_MOSI
            int "LCD MOSI GPIO"
            default 21

        config SNIFFER_LCD_CLK
            int "LCD CLK GPIO"
            default 15

        config SNIFFER_LCD_CS
            int "LCD CS GPIO"
            default 14

        config SNIFFER_LCD_DC
            int "LCD DC (Data/Command) GPIO"
            default 42

        config SNIFFER_LCD_RST
            int "LCD Reset GPIO"
            default 48

        config SNIFFER_LCD_BL
            int "LCD Backlight GPIO (fallback)"
            default 16

        config SNIFFER_LCD_BL_I2C
            bool "Use I2C backlight controller (Atom S3R)"
            default y

        config SNIFFER_LCD_BL_I2C_SDA
            int "I2C backlight SDA GPIO"
            default 45
            depends on SNIFFER_LCD_BL_I2C

        config SNIFFER_LCD_BL_I2C_SCL
            int "I2C backlight SCL GPIO"
            default 0
            depends on SNIFFER_LCD_BL_I2C

        config SNIFFER_BTN_GPIO
            int "Front button GPIO"
            default 41

    endmenu

endmenu
```

## sdkconfig.defaults
```kconfig
# Target
CONFIG_IDF_TARGET="esp32s3"

# Flash
CONFIG_ESPTOOLPY_FLASHSIZE_4MB=y
CONFIG_PARTITION_TABLE_CUSTOM=y
CONFIG_PARTITION_TABLE_CUSTOM_FILENAME="partitions.csv"

# UART (Modbus sniffing)
CONFIG_ESP_CONSOLE_USB_SERIAL_JTAG=y
CONFIG_ESP_CONSOLE_SECONDARY_NONE=y

# WiFi — override in sdkconfig.defaults.local (not checked in)
CONFIG_WIFI_SSID=""
CONFIG_WIFI_PASSWORD=""
CONFIG_ESP_WIFI_DYNAMIC_RX_BUFFER_NUM=32
CONFIG_ESP_WIFI_DYNAMIC_TX_BUFFER_NUM=32

# HTTP Server
CONFIG_HTTPD_MAX_REQ_HDR_LEN=1024
CONFIG_HTTPD_MAX_URI_LEN=512
CONFIG_HTTPD_WS_SUPPORT=y

# OTA — two-slot partition table + automatic rollback. A freshly OTA'd
# image boots in PENDING_VERIFY; if it fails to reach ota_mgr_mark_valid()
# (i.e. WiFi + HTTP server didn't come up), the bootloader rolls back to
# the previous good image on the next reset. Prevents a bad OTA bricking
# an unattended device.
CONFIG_BOOTLOADER_APP_ROLLBACK_ENABLE=y

# FreeRTOS
CONFIG_FREERTOS_HZ=1000

# Compiler
CONFIG_COMPILER_OPTIMIZATION_SIZE=y

# PSRAM — S3R has octal PSRAM; IGNORE_NOTFOUND lets S3 boot without it
CONFIG_SPIRAM=y
CONFIG_SPIRAM_MODE_OCT=y
CONFIG_SPIRAM_IGNORE_NOTFOUND=y
```
